## sdkconfig.defaults
```kconfig
# Target
CONFIG_IDF_TARGET="esp32p4"

# Flash
CONFIG_ESPTOOLPY_FLASHMODE_QIO=y
CONFIG_ESPTOOLPY_FLASHSIZE_16MB=y
CONFIG_SPI_FLASH_ERASE_YIELD_DURATION_MS=5

# Custom partition table
CONFIG_PARTITION_TABLE_CUSTOM=y

# PSRAM
CONFIG_SPIRAM=y
CONFIG_SPIRAM_SPEED_200M=y
CONFIG_SPIRAM_XIP_FROM_PSRAM=y

# Cache
CONFIG_CACHE_L2_CACHE_256KB=y
CONFIG_CACHE_L2_CACHE_LINE_128B=y

# Compiler
CONFIG_COMPILER_OPTIMIZATION_PERF=y

# Main task stack
CONFIG_ESP_MAIN_TASK_STACK_SIZE=10240

# FreeRTOS
CONFIG_FREERTOS_HZ=1000
CONFIG_FREERTOS_VTASKLIST_INCLUDE_COREID=y
CONFIG_FREERTOS_GENERATE_RUN_TIME_STATS=y

# LVGL OS
CONFIG_LV_OS_FREERTOS=y
CONFIG_LV_USE_CLIB_MALLOC=y
CONFIG_LV_USE_CLIB_STRING=y
CONFIG_LV_USE_CLIB_SPRINTF=y

# LVGL rendering
CONFIG_LV_DEF_REFR_PERIOD=15
CONFIG_LV_OBJ_STYLE_CACHE=y
CONFIG_LV_DRAW_SW_DRAW_UNIT_CNT=2

# LVGL color depth - RGB565
CONFIG_LV_COLOR_DEPTH_16=y

# LVGL font - required for large Chinese font file
CONFIG_LV_FONT_FMT_TXT_LARGE=y

# LVGL built-in fonts used in UI
CONFIG_LV_FONT_MONTSERRAT_16=y
CONFIG_LV_FONT_MONTSERRAT_20=y
CONFIG_LV_FONT_MONTSERRAT_24=y
CONFIG_LV_FONT_MONTSERRAT_28=y

# Don't build LVGL examples
CONFIG_LV_BUILD_EXAMPLES=n

# Display: 10.1" panel, triple buffer
CONFIG_BSP_LCD_TYPE_800_1280_10_1_INCH=y
CONFIG_BSP_LCD_DPI_BUFFER_NUMS=3
CONFIG_BSP_LCD_COLOR_FORMAT_RGB565=y

# Experimental features (ESP-IDF 5.5)
CONFIG_IDF_EXPERIMENTAL_FEATURES=y

# WiFi via esp_hosted (ESP32-P4 companion chip, ESP32-C6)
# Do NOT set ESP_HOST_WIFI_ENABLED - it disables esp_wifi_remote which is needed
# for companion chip communication. esp_wifi_remote must be enabled (default).
CONFIG_SLAVE_IDF_TARGET_ESP32C6=y
CONFIG_ESP_WIFI_SOFTAP_SUPPORT=n

# ESP-Hosted: SDIO transport (hardware wired for SDIO, NOT SPI)
CONFIG_ESP_HOSTED_SDIO_HOST_INTERFACE=y
CONFIG_ESP_HOSTED_SDIO_4_BIT_BUS=y
CONFIG_ESP_HOSTED_SDIO_BUS_WIDTH=4
CONFIG_ESP_HOSTED_SDIO_CLOCK_FREQ_KHZ=40000
CONFIG_ESP_HOSTED_SDIO_PIN_CMD=19
CONFIG_ESP_HOSTED_SDIO_PIN_CLK=18
CONFIG_ESP_HOSTED_SDIO_PIN_D0=14
CONFIG_ESP_HOSTED_SDIO_PIN_D1=15
CONFIG_ESP_HOSTED_SDIO_PIN_D2=16
CONFIG_ESP_HOSTED_SDIO_PIN_D3=17
CONFIG_ESP_HOSTED_SDIO_GPIO_RESET_SLAVE=54
CONFIG_ESP_HOSTED_SDIO_RESET_ACTIVE_HIGH=y
CONFIG_ESP_HOSTED_SDIO_OPTIMIZATION_RX_STREAMING_MODE=y

# WiFi Remote performance tuning (recommended by esp_hosted docs)
CONFIG_ESP_WIFI_STATIC_RX_BUFFER_NUM=16
CONFIG_ESP_WIFI_DYNAMIC_RX_BUFFER_NUM=64
CONFIG_ESP_WIFI_DYNAMIC_TX_BUFFER_NUM=64
CONFIG_ESP_WIFI_AMPDU_TX_ENABLED=y
CONFIG_ESP_WIFI_TX_BA_WIN=32
CONFIG_ESP_WIFI_AMPDU_RX_ENABLED=y
CONFIG_ESP_WIFI_RX_BA_WIN=32

CONFIG_LWIP_TCP_SND_BUF_DEFAULT=65534
CONFIG_LWIP_TCP_WND_DEFAULT=65534
CONFIG_LWIP_TCP_RECVMBOX_SIZE=64
CONFIG_LWIP_UDP_RECVMBOX_SIZE=64
CONFIG_LWIP_TCPIP_RECVMBOX_SIZE=64
CONFIG_LWIP_TCP_SACK_OUT=y

# Disable XIP from PSRAM for WiFi compatibility - use regular flash mapping
CONFIG_SPIRAM_XIP_FROM_PSRAM=n
```
